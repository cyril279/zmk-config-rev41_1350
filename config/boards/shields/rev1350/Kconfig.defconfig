## config/boards/shields/rev1350/Kconfig.defconfig
```kconfig
# Copyright (c) 2020 The ZMK Contributors
# SPDX-License-Identifier: MIT

if SHIELD_REV1350

config ZMK_KEYBOARD_NAME
    default "rev1350"

endif # SHIELD_REV1350

if ZMK_BACKLIGHT

config PWM
    default y

config LED_PWM
    default y

endif # ZMK_BACKLIGHT
```

## config/boards/shields/rev1350/Kconfig.shield
```kconfig
# Copyright (c) 2020 The ZMK Contributors
# SPDX-License-Identifier: MIT

config SHIELD_REV1350
    def_bool $(shields_list_contains,rev1350)
```
